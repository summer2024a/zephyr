## boards/amlogic/s905y4_2g/Kconfig
```kconfig
# SPDX-License-Identifier: Apache-2.0

config BOARD_S905Y4_2G
	select SOC_AMLOGIC_MESON_S4 if BOARD_S905Y4_2G_MESON_S4

config BOARD_S905Y4_2G_MESON_S4
	select SOC_AMLOGIC_MESON_S4
```

## boards/amlogic/s905y4_2g/Kconfig.defconfig
```kconfig
# SPDX-License-Identifier: Apache-2.0

if BOARD_S905Y4_2G

config ARM_ARCH_TIMER
	default y

config CACHE_MANAGEMENT
	default y

config SYS_CLOCK_HW_CYCLES_PER_SEC
	default 1000000000

config SYS_CLOCK_TICKS_PER_SEC
	default 1000

config NUM_IRQS
	default 256

config SOC_MESON_S4_BOOT_TRACE
	default n

# SHELL and SMP shell disabled for minimal single-core boot
config SOC_MESON_S4_SHELL_SMP
	default n

config SOC_PREP_HOOK
	default y

config ARMV8_A_NS
	default y

config UART_MESON
	default y

config MAX_XLAT_TABLES
	default 16

endif
```

## boards/amlogic/s905y4_2g/board.yml
```yaml
board:
  name: s905y4_2g
  full_name: Amlogic S4 S905Y4 2GB Development Board
  vendor: amlogic
  socs:
  - name: meson_s4
```

## boards/lynxi/he200/Kconfig
```kconfig
# SPDX-License-Identifier: Apache-2.0

source "boards/lynxi/he200/Kconfig.he200"
```

## boards/lynxi/he200/Kconfig.defconfig
```kconfig
# SPDX-License-Identifier: Apache-2.0

if BOARD_HE200

config ARM_ARCH_TIMER
	default y

config CACHE_MANAGEMENT
	default y

config SYS_CLOCK_HW_CYCLES_PER_SEC
	default 1000000000

config SYS_CLOCK_TICKS_PER_SEC
	default 100

config NUM_IRQS
	default 256

endif
```

## boards/lynxi/he200/Kconfig.he200
```kconfig
# SPDX-License-Identifier: Apache-2.0

config BOARD_HE200
	select SOC_LYNXI_KA200 if BOARD_HE200_KA200

config BOARD_HE200_KA200
	select SOC_LYNXI_KA200
```

## boards/lynxi/he200/board.yml
```yaml
board:
  name: he200
  full_name: Lynxi HE200 Development Board
  vendor: lynxi
  socs:
  - name: ka200
```

## boards/lynxi/he200_ep/Kconfig
```kconfig
# SPDX-License-Identifier: Apache-2.0

config BOARD_HE200_EP
	help
	  Zephyr board target for HE200 EP (KA200_EP silicon, SPL @ 0x800100000).
	  Shared peripherals use SOC_LYNXI_KA200; this board adds linker/SPL/early
	  UART only. Silicon SKU diff vs RC is PCIe EP — see PORTING.md §1.1.
	select SOC_LYNXI_KA200 if BOARD_HE200_EP_KA200

config BOARD_HE200_EP_KA200
	select SOC_LYNXI_KA200

# Memory configuration for he200_ep board
# IDT_LIST: 0x800000000 (32KB)

config IDT_LIST_BASE_ADDRESS
	hex "IDT List Base Address"
	default 0x800000000

config IDT_LIST_SIZE
	int "IDT List Size (KB)"
	default 32
```

## boards/lynxi/he200_ep/board.yml
```yaml
board:
  name: he200_ep
  full_name: Lynxi HE200 Entry Point Development Board
  vendor: lynxi
  socs:
  - name: ka200
```

## drivers/ethernet/Kconfig.lynxi
```kconfig
# Lynxi KA200 Ethernet (DesignWare MAC) configuration options
#
# Copyright (c) 2026 Lynxi Technologies Co., Ltd.
# SPDX-License-Identifier: Apache-2.0

config ETH_DWMAC_LYNXI_KA200
	bool "Synopsys DesignWare MAC on Lynxi KA200 (RGMII)"
	depends on SOC_LYNXI_KA200
	depends on DT_HAS_SNPS_DESIGNWARE_ETHERNET_ENABLED
	select ETH_DWMAC
	default y
	help
	  Platform glue for Lynxi KA200 / HE200 GMAC @ 0x10020000.
	  Enables CPR clock gates (CPR 0x8c), RGMII gigabit MAC setup,
	  and uncached DMA descriptor mapping. MDIO/PHY init is still
	  required for link-up (see boards/lynxi/PORTING.md).

if ETH_DWMAC_LYNXI_KA200

config LYNXI_DWMAC_LOG_LEVEL
	int "Lynxi DWMAC platform log level"
	default 3
	range 0 4
	help
	  0=none, 1=err, 2=wrn, 3=inf, 4=dbg

endif
```

## drivers/ethernet/Kconfig.meson_s4
```kconfig
# SPDX-License-Identifier: Apache-2.0

config ETH_DWMAC_MESON_S4
	bool "Synopsys DesignWare MAC driver for Amlogic S4"
	depends on NET_L2_ETHERNET
	depends on DT_HAS_AMLOGIC_MESON_AXG_DWMAC_ENABLED
	select ETH_DWMAC
	help
	  Enable Synopsys DesignWare MAC (DWMAC 3.70a) driver for
	  Amlogic S4 (S905Y4/S905W2) SoC.

	  S4 uses internal RMII PHY (ethernet-phy-id0180.3301) with
	  MDIO mux for internal/external PHY selection.
	  Maximum speed: 100Mbps (internal PHY).

config ETH_DWMAC_MESON_S4_LOG_LEVEL
	int "S4 DWMAC log level"
	depends on ETH_DWMAC_MESON_S4
	default 0
	help
	  Log level for S4 DWMAC driver.
```

## drivers/ethernet/mdio/Kconfig.lynxi
```kconfig
# Lynxi KA200 DWMAC4 MDIO configuration options
#
# Copyright (c) 2026 Lynxi Technologies Co., Ltd.
# SPDX-License-Identifier: Apache-2.0

config MDIO_LYNXI_DWMAC
	bool "Lynxi KA200 DWMAC4 MDIO"
	depends on MDIO
	depends on ETH_DWMAC_LYNXI_KA200
	depends on DT_HAS_LYNXI_DWMAC_MDIO_ENABLED
	default y
	help
	  MDIO master inside Synopsys DWMAC4 @ GMAC_MDIO_ADDR (0x200).
	  MDIO node must be a child of the Ethernet MAC devicetree node.
```

## drivers/sdhc/Kconfig.lynxi
```kconfig
# Copyright (c) 2026 Lynxi Technologies Co., Ltd.
# SPDX-License-Identifier: Apache-2.0

config SDHC_LYNXI_DWCMSHC
	bool "Lynxi DWC MSHC SDHCI host"
	default y
	depends on DT_HAS_LYNXI_DWCMSHC_SDHCI_ENABLED
	select SDHC_SUPPORTS_NATIVE_MODE
	help
	  Port of RT-Thread bsp/lynxi/he200/drivers/drv_sdhci.c. Differences:
	  R3/R4 OCR response[0] <<= 8 for Zephyr mmc_send_op_cond(); CMD TIMEOUT
	  is masked out of INT_ENABLE/SIGNAL (DWC reports 0x18000 before CC).

config LYNXI_DWCMSHC_DEBUG
	bool "Lynxi SDHCI register / IRQ probe printk"
	depends on SDHC_LYNXI_DWCMSHC
	default n
	help
	  Boot-time printk: host version, present state, interrupt regs,
	  and optional CMD0 IRQ self-test (see also CONFIG_SDHC_LOG_LEVEL).

config LYNXI_DWCMSHC_CMD_DEBUG
	bool "Print each SDHCI command on UART (printk)"
	depends on SDHC_LYNXI_DWCMSHC
	default y if LYNXI_DWCMSHC_DEBUG
	default n
	help
	  Log every CMD/data transaction (opcode, arg, ret, int_st) via printk
	  so it is visible even when CONFIG_LOG_PRINTK is disabled.

config LYNXI_DWCMSHC_INTERRUPT
	bool "Use GIC IRQ for SDHCI completion (RT sdhci_irq + event)"
	depends on SDHC_LYNXI_DWCMSHC
	default y
	help
	  Same as RT: IRQ posts completion to k_sem (rt_event). CMD wait is
	  sdhci_wait_command_done (ERROR|RESPONSE, fail on SDHCI_INT_ERROR).
	  If disabled, poll SDHCI_INT_STATUS in a tight loop (no IRQ).

config LYNXI_DWCMSHC_IRQ_SELFTEST
	bool "Run CMD0 IRQ self-test during SDHCI driver init"
	depends on SDHC_LYNXI_DWCMSHC && LYNXI_DWCMSHC_INTERRUPT
	default n
	help
	  Disabled by default: init-time CMD0 can block boot if card clock
	  is not up yet. Use shell / probe after disk_access_init instead.

config SDHC_BUFFER_ALIGNMENT
	default 64 if SDHC_LYNXI_DWCMSHC
```

## drivers/sdhc/Kconfig.meson
```kconfig
# SPDX-License-Identifier: Apache-2.0

config SDHC_MESON_AXG_MMC
	bool "Amlogic Meson AXG MMC SDHC driver"
	default y if DT_HAS_AMLOGIC_MESON_AXG_MMC_ENABLED
	depends on SDHC
	help
	  Enable Amlogic Meson AXG MMC controller driver for S4 SoC.

	  This driver supports the Meson MMC controller found in S4
	  (S905Y4/S905W2) SoCs, used for SD card and eMMC storage.

	  Register layout differs from DesignWare DWC MSHC (lynxi_dwcmshc).

config SDHC_MESON_AXG_MMC_INTERRUPT
	bool "Use interrupt-driven mode for Meson MMC"
	depends on SDHC_MESON_AXG_MMC
	default y
	help
	  Enable interrupt-driven transfer mode for Meson MMC controller.

config SDHC_MESON_AXG_MMC_DEBUG
	bool "Enable debug logging for Meson MMC"
	depends on SDHC_MESON_AXG_MMC
	default n
	help
	  Enable verbose debug logging for Meson MMC driver.
```

## drivers/serial/Kconfig.meson
```kconfig
# SPDX-License-Identifier: Apache-2.0

config UART_MESON
	bool "Amlogic Meson UART driver"
	default y if DT_HAS_AMLOGIC_MESON_S4_UART_ENABLED
	select SERIAL_HAS_DRIVER
	select SERIAL_SUPPORT_INTERRUPT
	help
	  Enable Amlogic Meson UART driver for S4 and later SoCs.

	  This UART has a different register layout from ns16550/DW APB:
	  WFIFO (0x00), RFIFO (0x04), CONTROL (0x08), STATUS (0x0C),
	  MISC (0x10), REG5 (0x14).

config UART_MESON_S4
	bool "Amlogic S4 Meson UART specific support"
	depends on UART_MESON
	default y if DT_HAS_AMLOGIC_MESON_S4_UART_ENABLED
	help
	  Enable S4-specific clock and baud rate configuration for Meson UART.

config UART_CONSOLE_MESON
	bool "Use Meson UART for console"
	depends on UART_MESON && UART_CONSOLE
	default y if DT_HAS_AMLOGIC_MESON_S4_UART_ENABLED
	help
	  Use Meson UART as the Zephyr console output device.
```

## dts/bindings/ethernet/mdio/lynxi,dwmac-mdio.yaml
```yaml
# Copyright (c) 2026 Lynxi Technologies Co., Ltd.
# SPDX-License-Identifier: Apache-2.0

description: Lynxi KA200 DWMAC4 embedded MDIO (Linux snps,dwmac-mdio compatible)

compatible: "lynxi,dwmac-mdio"

include: mdio-controller.yaml

properties:
  csr-clock-range:
    type: int
    default: 4
    description: |
      DWMAC4 MAC_MDIO_ADDRESS CR field (CSR clock range).
      4 = 150-250 MHz (lynchip-lite fabric_fout4 typical).
      See DWC QoS Ethernet databook Table 17-28.
```

## dts/bindings/pm_cpu_ops/arm,psci-1.0.yaml
```yaml
# Copyright (c) 2026 Amlogic, Inc.
# SPDX-License-Identifier: Apache-2.0

description: Power State Coordination Interface (PSCI) version 1.0.

compatible: "arm,psci-1.0"

include: arm_psci.yaml
```

## dts/bindings/sdhc/lynxi,dwcmshc-sdhci.yaml
```yaml
# Copyright (c) 2026 Lynxi Technologies Co., Ltd.
# SPDX-License-Identifier: Apache-2.0

description: Lynxi DWC MSHC SDHCI (HE200 eMMC/SD)

compatible: "lynxi,dwcmshc-sdhci"

include: sdhc.yaml

properties:
  reg:
    required: true

  interrupts:
    required: false

  lynxi,emmc:
    type: boolean
    description: Fixed eMMC (non-removable), sets CARD_IS_EMMC

  lynxi,io-1v8:
    type: boolean
    description: Use 1.8V PHY pad configuration (RT BSP_SDIO0_1V8)
```

## dts/bindings/serial/amlogic,meson-s4-uart.yaml
```yaml
description: Amlogic Meson S4 UART

compatible: "amlogic,meson-s4-uart"

include: [uart-controller.yaml]

properties:
  reg:
    required: true

  interrupts:
    required: true
```

## soc/amlogic/Kconfig
```kconfig
# SPDX-License-Identifier: Apache-2.0

# Amlogic SoC family

config SOC_FAMILY_AMLOGIC
	bool

config SOC_FAMILY
	default "amlogic" if SOC_FAMILY_AMLOGIC

rsource "*/Kconfig.soc"

if SOC_FAMILY_AMLOGIC

rsource "*/Kconfig"

endif
```

## soc/amlogic/s4/Kconfig
```kconfig
# SPDX-License-Identifier: Apache-2.0

config SOC_AMLOGIC_MESON_S4
	select ARM64
	select CPU_CORTEX_A
	select ARMV8_A
	select ARMV8_A_FP
	select CPU_HAS_MMU
	select ARMV8_A_TIMER
	select CACHE_L2
	select GIC
	select GIC_V2
	select TIMER_ARMv8_CNTVCT
	select SYS_CLOCK_EXISTS
	select SOC_PER_CORE_INIT_HOOK if SMP
	help
	  Amlogic Meson S4 (S905W2/S905Y4) ARM64 SoC (4 Cortex-A55 cores).

	  PSCI firmware in BL31 handles secondary CPU boot via SMC.
	  GIC-400 interrupt controller. Meson UART, DW MAC 3.70a with
	  internal RMII PHY, Meson AXG MMC controller, XHCI USB.

config SOC_MESON_S4_BOOT_TRACE
	bool "S4 boot trace on UART_B (early markers)"
	depends on SOC_AMLOGIC_MESON_S4
	default n
	help
	  Optional early-boot UART trace beyond the always-on boot markers.
	  Adds character markers at key boot stages on UART_B @ 115200.

config SOC_MESON_S4_SHELL_SMP
	bool "Shell command meson_s4_smp (SMP status)"
	depends on SOC_AMLOGIC_MESON_S4 && SHELL
	default n
	help
	  Register meson_s4_smp shell command for PSCI / online CPU check.

config SOC_MESON_S4_SMP_AUTO_PROBE
	bool "Auto z_smp_init from main() after Hello World (debug)"
	depends on SOC_AMLOGIC_MESON_S4 && SMP && SMP_BOOT_DELAY
	default n
	help
	  Call z_smp_init from hello_world main(). Debug only.

config SOC_MESON_S4_SMP_DEFER_INIT
	bool "Defer z_smp_init 3s via k_work (SMP_BOOT_DELAY debug)"
	depends on SOC_AMLOGIC_MESON_S4 && SMP && SMP_BOOT_DELAY
	default n
	help
	  Schedule z_smp_init on system workqueue 3s after boot.
	  Use for SMP validation without Shell.

config SOC_MESON_S4_SMP_DEBUG
	bool "Verbose SMP printk trace on UART"
	depends on SOC_AMLOGIC_MESON_S4 && SMP
	default n
	help
	  Layered s4: / smp: printf in kernel and arch SMP paths.
	  Disable for Shell / production testing.
```
