## soc/amlogic/s4/Kconfig.defn
```kconfig
# SPDX-License-Identifier: Apache-2.0

if SOC_AMLOGIC_MESON_S4

config SOC_FAMILY
	default "amlogic"

config SOC_SERIES
	default "s4"

config NUM_IRQS
	default 256

config SYS_CLOCK_HW_CYCLES_PER_SEC
	default 1000000000

config SYS_CLOCK_TICKS_PER_SEC
	default 1000

config ARM_ARCH_TIMER
	default y

config CACHE_MANAGEMENT
	default y

config SOC_MESON_S4_BOOT_TRACE
	default n

endif
```

## soc/amlogic/s4/Kconfig.soc
```kconfig
# SPDX-License-Identifier: Apache-2.0

config SOC_SERIES_S4
	bool
	select SOC_FAMILY_AMLOGIC

config SOC_AMLOGIC_MESON_S4
	bool
	select SOC_SERIES_S4

config SOC_SERIES
	default "s4" if SOC_SERIES_S4

config SOC
	default "meson_s4" if SOC_AMLOGIC_MESON_S4
```

## soc/lynxi/Kconfig
```kconfig
# Lynxi SoC family

# SPDX-License-Identifier: Apache-2.0

config SOC_FAMILY_LYNXI
	bool

config SOC_FAMILY
	default "lynxi" if SOC_FAMILY_LYNXI

rsource "*/Kconfig.soc"

if SOC_FAMILY_LYNXI

rsource "*/Kconfig"

endif
```

## soc/lynxi/ka200/Kconfig
```kconfig
# SPDX-License-Identifier: Apache-2.0

config SOC_LYNXI_KA200
	select ARM64
	select CPU_CORTEX_A
	select ARMV8_A
	select ARMV8_A_FP
	select CPU_HAS_MMU
	select ARMV8_A_TIMER
	select CACHE_L2
	select GIC
	select GIC_V3
	select TIMER_ARMv8_CNTVCT
	select SYS_CLOCK_EXISTS
	help
	  Lynxi KA200 ARM64 SoC (8 cores).

	  All silicon SKUs on this SoC (e.g. KA200_EP, KA200_RC) share the same
	  peripherals and drivers here (UART, eMMC, SMP, MMU regions, sysctl).
	  SKU differences are limited to PCIe (EP vs RC); use board-level
	  Kconfig/DTS only for PCIe and boot packaging, not duplicate SoC drivers.
	  See boards/lynxi/PORTING.md section 1.1.

config SOC_LYNXI_KA200_SPIN_TABLE
	bool "Use spin-table to boot secondary CPUs (no PSCI)"
	default y
	depends on SOC_LYNXI_KA200
	help
	  KA200 / HE200 firmware does not implement PSCI CPU_ON. Match
	  RT-Thread cpu_release_paddr[] at 0x401ff00..0x401ff30.

config SOC_KA200_BOOT_TRACE
	bool "KA200 boot trace on UART0 (__start / EL2 / MMU extra markers)"
	depends on SOC_LYNXI_KA200
	default n
	help
	  Optional SPL direct-boot trace beyond the always-on PLtbdDmi markers.
	  Adds 'S' at __start, 'G'/'g' EL2 GIC SRE, 'M'/'T'/'E' during MMU init,
	  and "Zephyr SPL" banner. UART0 @ 115200 (50MHz CPR clock).

config SOC_LYNXI_KA200_SHELL_SMP
	bool "Shell command ka200_smp (SMP status)"
	depends on SOC_LYNXI_KA200 && SHELL
	default y
	help
	  Register ka200_smp for spin-table / online CPU check on UART.
```

## soc/lynxi/ka200/Kconfig.defn
```kconfig
# SPDX-License-Identifier: Apache-2.0

if SOC_LYNXI_KA200

config SOC_FAMILY
	default "lynxi"

config SOC_SERIES
	default "ka200"

config NUM_IRQS
	default 220

config SYS_CLOCK_HW_CYCLES_PER_SEC
	default 1000000000

config SYS_CLOCK_TICKS_PER_SEC
	default 100

config ARM_ARCH_TIMER
	default y

config CACHE_MANAGEMENT
	default y

endif
```

## soc/lynxi/ka200/Kconfig.soc
```kconfig
# SPDX-License-Identifier: Apache-2.0

config SOC_SERIES_KA200
	bool
	select SOC_FAMILY_LYNXI

config SOC_LYNXI_KA200
	bool
	select SOC_SERIES_KA200

config SOC_SERIES
	default "ka200" if SOC_SERIES_KA200

config SOC
	default "ka200" if SOC_LYNXI_KA200
```
